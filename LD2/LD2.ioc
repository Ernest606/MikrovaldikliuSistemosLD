# file: LD2.ioc
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Mcu.Family=STM32F4
Mcu.Name=STM32F407V(E-G)Tx
Mcu.Package=LQFP100
NVIC.PriorityGroup=NVIC_PRIORITYGROUP_0
ProjectManager.HeapSize=0x200
ProjectManager.StackSize=0x400
ProjectManager.TargetToolchain=STM32CubeIDE
RCC.48MHZClocksFreq_Value=20571428.57142857
RCC.AHBFreq_Value=72000000
RCC.APB1CLKDivider=RCC_HCLK_DIV2
RCC.APB1Freq_Value=36000000
RCC.APB1TimFreq_Value=72000000
RCC.APB2Freq_Value=72000000
RCC.APB2TimFreq_Value=72000000
RCC.CortexFreq_Value=72000000
RCC.HCLKFreq_Value=72000000
RCC.HSE_VALUE=8000000
RCC.HSI_VALUE=16000000
RCC.PLLM=8
RCC.PLLN=72
RCC.PLLQ=7
RCC.SYSCLKFreq_VALUE=72000000
RCC.SYSCLKSource=RCC_SYSCLKSOURCE_PLLCLK
RCC.VCOOutputFreq_Value=144000000
board=STM32F407G-DISC1

// file: Core/Src/main.c
/* USER CODE BEGIN Header */
/**
  ******************************************************************************
  * @file           : main.c
  * @brief          : Main program body
  ******************************************************************************
  * @attention
  *
  * Copyright (c) 2024 STMicroelectronics.
  * All rights reserved.
  *
  * This software is licensed under terms that can be found in the LICENSE file
  * in the root directory of this software component.
  * If no LICENSE file comes with this software, it is provided AS-IS.
  *
  ******************************************************************************
  */
/* USER CODE END Header */
#include "main.h"

void SystemClock_Config(void);
void GPIO_Init(void);

int main(void)
{
  /* USER CODE BEGIN 1 */
	int uzd_nr = 4;
	int freq = 1000;
  /* USER CODE END 1 */

  /* MCU Configuration--------------------------------------------------------*/

  /* Reset of all peripherals, Initializes the Flash interface and the Systick. */
  HAL_Init();

  /* USER CODE BEGIN Init */
  GPIO_Init();
  /* USER CODE END Init */

  /* Configure the system clock */
  SystemClock_Config();

  /* Initialize all configured peripherals */

  /* Infinite loop */
  while (1)
  {
	  if (uzd_nr == 1){
	  		  GPIOD->BSRR = 0x90000000;
	  		  HAL_Delay(1000);
	  		  GPIOD->BSRR = 0x8000;
	  		  HAL_Delay(1000);
	  		  GPIOD->BSRR = 0x1000;
	  		  HAL_Delay(1000);
	  	  }
	  	  else if (uzd_nr == 2 ) {
	  		  GPIOD->BSRR = 0x60000000;
	  		  HAL_Delay(1000);
	  		  GPIOD->BSRR = 0x4000;
	  		  HAL_Delay(1000);
	  		  GPIOD->BSRR = 0x40000000;
	  		  HAL_Delay(1000);
	  		  GPIOD->BSRR = 0x4000;
	  		  HAL_Delay(1000);
	  		  GPIOD->BSRR = 0x40000000;
	  		  HAL_Delay(1000);
	  		  GPIOD->BSRR = 0x6000;
	  		  HAL_Delay(1000);
	  	  }
	  	  else if (uzd_nr == 3) {
	  		  if ((GPIOA->IDR & 0x0001) == 1) {
	  			  GPIOD->ODR = 0x8000;
	  		  }
	  		  else {
	  			  GPIOD->ODR = 0x00000000U;
	  		  }
	  	  }
	  	  else if (uzd_nr == 4) {
	  		  if ((GPIOA->IDR & 0x0001) == 1) {
	  			  freq = freq + 500;
	  		  }
	  		  if (GPIOD->ODR & (1 << 13)) {
	  			  GPIOD->BSRR = (1 << (13 + 16));
	  			  HAL_Delay(freq);
	  		  }
	  		  else {
	  			  GPIOD->BSRR = (1 << 13);
	  			  HAL_Delay(freq);
	  		  }
	  	  }
  }
}

void SystemClock_Config(void)
{
  RCC_OscInitTypeDef RCC_OscInitStruct = {0};
  RCC_ClkInitTypeDef RCC_ClkInitStruct = {0};

  /** Configure the main internal regulator output voltage
  */
  __HAL_RCC_PWR_CLK_ENABLE();
  __HAL_PWR_VOLTAGESCALING_CONFIG(PWR_REGULATOR_VOLTAGE_SCALE1);

  /** Initializes the RCC Oscillators according to the specified parameters
  * in the RCC_OscInitTypeDef structure.
  */
  RCC_OscInitStruct.OscillatorType = RCC_OSCILLATORTYPE_HSI;
  RCC_OscInitStruct.HSIState = RCC_HSI_ON;
  RCC_OscInitStruct.HSICalibrationValue = RCC_HSICALIBRATION_DEFAULT;
  RCC_OscInitStruct.PLL.PLLState = RCC_PLL_ON;
  RCC_OscInitStruct.PLL.PLLSource = RCC_PLLSOURCE_HSI;
  RCC_OscInitStruct.PLL.PLLM = 8;
  RCC_OscInitStruct.PLL.PLLN = 72;
  RCC_OscInitStruct.PLL.PLLP = RCC_PLLP_DIV2;
  RCC_OscInitStruct.PLL.PLLQ = 7;
  if (HAL_RCC_OscConfig(&RCC_OscInitStruct) != HAL_OK)
  {
    Error_Handler();
  }

  /** Initializes the CPU, AHB and APB buses clocks
  */
  RCC_ClkInitStruct.ClockType = RCC_CLOCKTYPE_HCLK|RCC_CLOCKTYPE_SYSCLK
                              |RCC_CLOCKTYPE_PCLK1|RCC_CLOCKTYPE_PCLK2;
  RCC_ClkInitStruct.SYSCLKSource = RCC_SYSCLKSOURCE_PLLCLK;
  RCC_ClkInitStruct.AHBCLKDivider = RCC_SYSCLK_DIV1;
  RCC_ClkInitStruct.APB1CLKDivider = RCC_HCLK_DIV2;
  RCC_ClkInitStruct.APB2CLKDivider = RCC_HCLK_DIV1;

  if (HAL_RCC_ClockConfig(&RCC_ClkInitStruct, FLASH_LATENCY_2) != HAL_OK)
  {
    Error_Handler();
  }
}

/* USER CODE BEGIN 4 */
void GPIO_Init(void)
{
    RCC->AHB1ENR = 0x00000009;

    GPIOD->MODER = 0x55000000;
    GPIOD->OTYPER = 0x00000000U;
    GPIOD->OSPEEDR = 0x00000002U;
    GPIOD->PUPDR = 0x00000000U;

    GPIOA->MODER = 0x00000000U;
    GPIOA->OSPEEDR = 0x00000002U;
    GPIOA->PUPDR = 0x00000000U;
}
/* USER CODE END 4 */

void Error_Handler(void)
{
  __disable_irq();
  while (1)
  {
  }
}
